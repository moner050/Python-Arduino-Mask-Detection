#include <Wire.h>
#include <Adafruit_MLX90614.h>
#include <LiquidCrystal_I2C.h>
#include "talkie.h"

#define I2C_ADDR 0x27 //I2C Address
#define BACKLIGHT_PIN 3
#define mskOff 12
#define mskOn  13
#define espRedLED 5
#define espGreenLED 6

Talkie voice;
const uint8_t sp1[] PROGMEM = {0x80, 0xa2, 0x22, 0x4d, 0xdd, 0xd4, 0x66, 0xf2, 0x8a, 0x76, 0x73, 0x55, 0x5b,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 0xf0, 0xff};
const uint8_t sp2[] PROGMEM = {0xa0, 0x30, 0x71, 0x55, 0x66, 0x98, 0x71, 0xd1, 0xc5, 0x65, 0xbf, 0x45, 0xc6,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 0x1e, 0xff};
const uint8_t sp3[] PROGMEM = {0x4a, 0x07, 0x5f, 0x4b, 0x8c, 0xd4, 0x24, 0x03, 0xfc, 0xa8, 0x0a, 0xb1, 0x7c, 0x34, 0x96, 0xc2, 0x33, 0xa8, 0xcd, 0x51, 0x82, 0x37, 0x0f, 0xa5, 0xa4,
0x47, 0x8e, 0xce, 0xcd, 0x1d, 0x93, 0x1e, 0x31, 0x38, 0x8f, 0x14, 0x4e, 0x72, 0x38, 0x5e, 0x22, 0x5c, 0xac, 0x59, 0x12, 0x71, 0x9a, 0x9a, 0xd0, 0x38, 0x8e, 0x2f, 0x4c, 0xdc, 0xdd, 0x93, 0x22,
0xa0, 0xe5, 0x50, 0xd3, 0x67, 0xc7, 0xcc, 0x62, 0x71, 0x11, 0x1f, 0xa5, 0x8a, 0x7a, 0x36, 0x46, 0x40, 0x89, 0x54, 0x4d, 0x74, 0x46, 0xba, 0xd2, 0xe2, 0x2c, 0x8e, 0xa4, 0xe9, 0x08, 0x4a, 0x7a,
0x58, 0x6e, 0xbb, 0xab, 0x31, 0xd9, 0xa2, 0xb8, 0xaf, 0xe9, 0x16, 0xa7, 0x87, 0xb0, 0x3a, 0xa6, 0x86, 0x9d, 0x1f, 0x42, 0x9b, 0x9a, 0x6a, 0x76, 0xb7, 0x08, 0x9e, 0x66, 0x3b, 0xb9, 0x69, 0xa2,
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0xd1, 0x56, 0xb0, 0xa9, 0x71, 0x51, 0x23, 0x3f, 0xd3, 0xd9, 0xc4, 0x07, 0x5d, 0x62, 0xcd, 0xea, 0x00, 0x00, 0x3c, 0xff};

LiquidCrystal_I2C lcd(I2C_ADDR,16,2);

Adafruit_MLX90614 mlx = Adafruit_MLX90614();
void setup() 
{
  Wire.begin();
  pinMode(mskOff,INPUT);
  pinMode(mskOn,INPUT);
  pinMode(espRedLED,OUTPUT);
  pinMode(espGreenLED,OUTPUT);
  
  mlx.begin();
  Serial.begin(9600);
  pinMode(2,INPUT); // IR센서 핀 2로 설정
  lcd.begin(16,2);
  lcd.setBacklight(HIGH); // LCD Backlight ON
  lcd.home ();

}

void loop() 
{
  int isMaskOff = digitalRead(mskOff);
  int isMaskOn = digitalRead(mskOn);

  
   if(digitalRead(2)==LOW && isMaskOff)
   {
      delay(1500);
      MskOff();
   }
   else if(digitalRead(2)==LOW && isMaskOn)
   {
      delay(1500);
      MskOn();
   }
   else
   {
      Blank();
   }
}

void MskOff()
{
  lcd.clear();
  digitalWrite(espRedLED, HIGH);
  digitalWrite(espGreenLED, LOW);
  lcd.clear();
  lcd.setCursor(0,0);
  lcd.print("Target ");
  lcd.print(mlx.readObjectTempC() + 2);
  lcd.print(" C");
  lcd.setCursor(0,1);
  lcd.print("No Mask! ");
  voice.say(sp3);
  delay(2500);
}

void MskOn()
{
  lcd.clear();
  lcd.setCursor(0,0);
  lcd.print("Target ");
  lcd.print(mlx.readObjectTempC()+2);
  lcd.print(" C");
  lcd.setCursor(0,1);
  if((mlx.readObjectTempC() + 2) >= 36.0 && (mlx.readObjectTempC() + 2) <= 37.5)
  {
    lcd.print("   GOOD!");
    digitalWrite(espRedLED, LOW);
    digitalWrite(espGreenLED, HIGH);
    voice.say(sp1);
    delay(2500);
  }
  else if((mlx.readObjectTempC() + 2) < 36.0)
  {
    lcd.print("Temp is LOW! ");
    digitalWrite(espRedLED, LOW);
    digitalWrite(espGreenLED, HIGH);
    voice.say(sp1);
    delay(2500);
  }
  else
  {
    lcd.print("Temp is HIGH! ");
    digitalWrite(espRedLED, HIGH);
    digitalWrite(espGreenLED, LOW);
    voice.say(sp2);
    delay(2500);
  }
}

void Blank()
{
  lcd.clear();
  digitalWrite(espRedLED, LOW);
  digitalWrite(espGreenLED, LOW);
  lcd.setCursor(0,0);
  lcd.print("Here Temp ");
  lcd.print(mlx.readAmbientTempC()-1.5);
  lcd.print("C");
  lcd.setCursor(0,1);
  if((mlx.readAmbientTempC() - 1.5) <= 28) 
  {
    lcd.print("Good Weather");
    delay(2500);
  }
  else
  {
    lcd.print("Bad Weather ");
    delay(2500);
  }
}
